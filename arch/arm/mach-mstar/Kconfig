## arch/arm/mach-mstar/Kconfig
```kconfig
menu "MStar/SigmaStar v7 options"
	depends on ARCH_MSTARV7

config MSTAR_IPL
	bool "u-boot is being loaded by the vendor IPL"
	imply SPI
	imply DM_SPI
	imply DM_SPI_FLASH
	imply MSTAR_MSC313SPINOR
	imply SPL_SPI_SUPPORT
	imply SPL_SPI_FLASH_SUPPORT
	imply SPL_DM_SPI
	imply SPL_DM_SPI_FLASH
	imply SPI_FLASH_WINBOND
	imply MTD
	imply MTD_UBI
	imply CMD_UBI
	imply DM_MTD
	imply MTD_SPI_NAND
	imply SPL_MTD_SUPPORT
	imply SPL_YMODEM_SUPPORT
	imply DM_ETH
	imply MACB
	imply NET_RANDOM_ETHADDR
	imply MII
	imply PHY_MSTAR
	imply CMD_DHCP
	select SPL_STACK_R
	help
	  Say y here if you are loading u-boot via the vendor
	  IPL. Note that the image can only be 48KB or less
	  for the IPL to load it so this only really applies
	  to a SPL/TPL.

config MSTAR_INFINITY1
	bool "infinity1 family"

config MSTAR_INFINITY2M
	bool "infinity2m family"

config MSTAR_INFINITY3
	bool "infinity3 family"

config MSTAR_MERCURY5
	bool "mercury5 family"

choice
     prompt "Board type"

config TARGET_MSTARV7
	bool "Generic MStar/SigmaStar v7 boards"
	select MULTI_DTB_FIT

config TARGET_BREADBEE
	bool "Support breadbee boards"
	depends on !MSTAR_MERCURY5
	select SPL_DM_SPI
	select MSTAR_INFINITY1
	select MSTAR_INFINITY3
	select DM_ETH
	select MACB
	select CMD_DHCP
	select NET_RANDOM_ETHADDR
	select MII
	select PHY_MSTAR
	select REGMAP
	select MMC
	select DM_MMC
	select MMC_MSTAR
	select CMD_MMC
	select CMD_FAT
	select PINCTRL
	select PINCTRL_MSTAR

endchoice

endmenu

if ARCH_MSTARV7

config NR_DRAM_BANKS
	default 1

config SPL_TEXT_BASE
	default 0x23c00000 if MSTAR_IPL
	default 0xa0000000

config SPL_LDSCRIPT
	default "arch/arm/mach-mstar/u-boot-spl.lds"

config SYS_TEXT_BASE
	default	0x20000000

# Because the SRAM is pretty small we need to start using
# the DRAM for stack and heap as soon as possible.
# There is always at least 64MB of DRAM so put our new
# stack there.
config SPL_STACK_R_ADDR
	default 0x24000000
#

config ENV_SIZE
	default 0x2000

config ENV_OFFSET
	default 0x2000

config ENV_SECT_SIZE
	default 4096

config SYS_SPI_U_BOOT_OFFS
	default 0x20000

config SYS_MALLOC_LEN
	default 0x80000

config SYS_MALLOC_F_LEN
        default 0x4000

config FS_FAT_MAX_CLUSTSIZE
	default 4096

config DEBUG_UART_BASE
	default 0x1f221000

config DEBUG_UART_CLOCK
	default 172000000

config DEBUG_UART_SHIFT
	default 3

config SPL_SIZE_LIMIT
	default 0xa800 if MSTAR_INFINITY2M
	default 0xc000

config SYS_SOC
	default "mstarv7"

endif
```

## board/thingyjp/predita/Kconfig
```kconfig
if TARGET_PREDITA

config SYS_BOARD
	default "predita"

config SYS_VENDOR
	default "thingyjp"

config SYS_CONFIG_NAME
	default "predita"

config BOARD_SPECIFIC_OPTIONS # dummy
	def_bool y

config OF_LIST
	default "mstar-pioneer3-ssd210-predita"

config DEFAULT_DEVICE_TREE
	default "mstar-pioneer3-ssd210-predita"

config ENV_UBI_PART
	default "ubi"

config ENV_UBI_VOLUME
	default "env"

config SPL_UBI
        default y
config SPL_UBI_MAX_VOL_LEBS
        default 256
config SPL_UBI_MAX_PEB_SIZE
        default 131072
# Enough for 512MB
config SPL_UBI_MAX_PEBS
        default 4096
config SPL_UBI_VOL_IDS
        default 8
config SPL_UBI_PEB_OFFSET
        default 32
config SPL_UBI_VID_OFFSET
        default 2048
config SPL_UBI_LEB_START
        default 4096
config SPL_UBI_LOAD_MONITOR_ID
#        default 0
	default 4
endif
```

## configs/mstar_pioneer3_predita_defconfig
```kconfig
CONFIG_ARM=y
CONFIG_ARCH_MSTARV7=y
CONFIG_MSTAR_PIONEER3=y
CONFIG_TARGET_PREDITA=y
#CONFIG_MSTAR_IPL=y

CONFIG_MSTAR_BANG_BOOT0=y

#CONFIG_DEBUG_LL=y
#CONFIG_DEBUG_LL_UART_8250=y
#CONFIG_DEBUG_UART_PHYS=0x1f221000
#CONFIG_DEBUG_UART_8250_SHIFT=3

#CONFIG_DEBUG_UART=y
#CONFIG_DEBUG_UART_SKIP_INIT=y
#CONFIG_DEBUG_UART_ANNOUNCE=y
CONFIG_MTDPARTS_DEFAULT="spi-nand0:-@4096K(ubi)"
```

## configs/mstarv7_defconfig
```kconfig
CONFIG_ARM=y
CONFIG_ARCH_MSTARV7=y
CONFIG_MSTAR_IPL=y
CONFIG_DEFAULT_DEVICE_TREE="mstar-infinity2m-ssd202d"
CONFIG_OF_LIST="mstar-infinity2m-ssd202d"
```

## drivers/ddr/mstar/Kconfig
```kconfig
menu "MStar/SigmaStar DDR controller"
	depends on ARCH_MSTARV7

config MSTAR_MIU
	bool "MStar/SigmaStar MIU DDR controller"
	
config MSTAR_MIU_DEBUG
	bool "Output lots of debug info when setting up DRAM"
	depends on MSTAR_MIU

endmenu
```
